## app/boards/cpy_rename_f411ce/board.yml
```yaml
board:
  name: cpy_rename_f411ce
  full_name: Cpy Rename Black Pill V2.0
  vendor: zephyr_course
  socs:
    - name: stm32f411xe
```

## app/boards/scratch_f411ce/board.yml
```yaml
board:
  name: scratch_f411ce
  full_name: Scratch Black Pill V2.0
  vendor: zephyr_course
  socs:
    - name: stm32f411xe
```

## app/drivers/custom_sensor_led/Kconfig
```kconfig
config CUSTOM_SENSOR_LED
    bool "Led sensor driver"
    default y
    depends on DT_HAS_CUSTOM_SENSOR_LED_ENABLED
    select GPIO

    help
        Enable the custom led sensor driver
```

## twister-out/native_sim_native/host_gnu/zephyr-course/tests/ring_buf/homework.unit.ring_buf/Kconfig/Kconfig.modules
```kconfig
menu "cmsis_6 (/home/alexis/Repos/zephyr_repo/deps/modules/hal/cmsis_6)"
osource "$(ZEPHYR_CMSIS_6_KCONFIG)"
config ZEPHYR_CMSIS_6_MODULE
	bool
	default y
endmenu
config ZEPHYR_HAL_STM32_MODULE
	bool
	default y

config ZEPHYR_HAL_STM32_MODULE_BLOBS
	bool
```

## twister-out/native_sim_native/host_gnu/zephyr-course/tests/ring_buf/homework.unit.ring_buf/Kconfig/arch/Kconfig.tmp
```kconfig
# Load Zephyr Arch Kconfig descriptions.
osource "/home/alexis/Repos/zephyr_repo/deps/zephyr/arch/rx/Kconfig"
osource "/home/alexis/Repos/zephyr_repo/deps/zephyr/arch/x86/Kconfig"
osource "/home/alexis/Repos/zephyr_repo/deps/zephyr/arch/xtensa/Kconfig"
osource "/home/alexis/Repos/zephyr_repo/deps/zephyr/arch/sparc/Kconfig"
osource "/home/alexis/Repos/zephyr_repo/deps/zephyr/arch/riscv/Kconfig"
osource "/home/alexis/Repos/zephyr_repo/deps/zephyr/arch/posix/Kconfig"
osource "/home/alexis/Repos/zephyr_repo/deps/zephyr/arch/openrisc/Kconfig"
osource "/home/alexis/Repos/zephyr_repo/deps/zephyr/arch/mips/Kconfig"
osource "/home/alexis/Repos/zephyr_repo/deps/zephyr/arch/arm64/Kconfig"
osource "/home/alexis/Repos/zephyr_repo/deps/zephyr/arch/arm/Kconfig"
osource "/home/alexis/Repos/zephyr_repo/deps/zephyr/arch/arc/Kconfig"
```

## twister-out/native_sim_native/host_gnu/zephyr-course/tests/ring_buf/homework.unit.ring_buf/Kconfig/boards/Kconfig.defconfig.tmp
```kconfig
# Load Zephyr board defconfig descriptions.
osource "/home/alexis/Repos/zephyr_repo/deps/zephyr/boards/native/native_sim/Kconfig.defconfig"
```

## twister-out/native_sim_native/host_gnu/zephyr-course/tests/ring_buf/homework.unit.ring_buf/Kconfig/boards/Kconfig.native_sim
```kconfig
# Load board Kconfig descriptions.
osource "/home/alexis/Repos/zephyr_repo/deps/zephyr/boards/native/native_sim/Kconfig.native_sim"
```
